AUTOSAR XML (schema 00048)
package /myproject/Service/Someip/Deployment
  someip service interface deployment IAMApp02_Systest_Config_Dep: service-interface=IAMApp02_Systest_Config, service-interface-id=4002, service-interface-version={major-version=1, minor-version=0}
    9 x someip method deployment, all with maximum-segment-length-request=0, maximum-segment-length-response=0, separation-time-request=0.0, separation-time-response=0.0, transport-protocol=UDP:
      Someip_CallService01Ins01Method01Dep: method=CallService01Ins01Method01, method-id=3
      Someip_GetterService01Ins01Field01NotifierDep: method=GetterService01Ins01Field01Notifier, method-id=6
      Someip_SetterService01Ins01Field01NotifierDep: method=SetterService01Ins01Field01Notifier, method-id=7
      Someip_StartFindServiceDep: method=StartFindService, method-id=1
      Someip_StopFindServiceDep: method=StopFindService, method-id=2
      Someip_SubcribeService01Ins01Event01Dep: method=SubcribeService01Ins01Event01, method-id=4
      Someip_SubcribeService01Ins01Field01NotifierDep: method=SubcribeService01Ins01Field01Notifier, method-id=8
      Someip_UnsubcribeService01Ins01Event01Dep: method=UnsubcribeService01Ins01Event01, method-id=5
      Someip_UnsubcribeService01Ins01Field01NotifierDep: method=UnsubcribeService01Ins01Field01Notifier, method-id=9
package /myproject/test
  service interface IAMApp02_Systest_Config: major-version=1, minor-version=0
    namespaces:
      symbol props myproject
      symbol props test
    methods:
      9 x operation, all with fire-and-forget=false:
        CallService01Ins01Method01
          arg result: type=bool, direction=OUT
          arg description: type=String, direction=OUT
        GetterService01Ins01Field01Notifier
          arg result: type=bool, direction=OUT
          arg description: type=String, direction=OUT
        SetterService01Ins01Field01Notifier
          arg result: type=bool, direction=OUT
          arg description: type=String, direction=OUT
          arg setValue: type=uint32_t, direction=IN
        StartFindService
          arg serviceId: type=uint32_t, direction=IN
          arg result: type=bool, direction=OUT
          arg description: type=String, direction=OUT
        StopFindService
          arg serviceId: type=uint32_t, direction=IN
          arg result: type=bool, direction=OUT
          arg description: type=String, direction=OUT
        SubcribeService01Ins01Event01
          arg result: type=bool, direction=OUT
          arg description: type=String, direction=OUT
        SubcribeService01Ins01Field01Notifier
          arg result: type=bool, direction=OUT
          arg description: type=String, direction=OUT
        UnsubcribeService01Ins01Event01
          arg result: type=bool, direction=OUT
          arg description: type=String, direction=OUT
        UnsubcribeService01Ins01Field01Notifier
          arg result: type=bool, direction=OUT
          arg description: type=String, direction=OUT
