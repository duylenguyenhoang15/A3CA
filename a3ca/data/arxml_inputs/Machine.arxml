AUTOSAR XML (schema 00048)
package /Machine
  mode declaration group AppMode_ModeDeclarationGroup_1
    mode FG1
    mode Off
  mode declaration group ApplicationStates: initial-mode=ApplicationStates/Terminating
    mode Running: value=0
    mode Terminating: value=1
  someip sd client service instance config ClientSdConfig_1: initial-find-behavior={initial-delay-max-value=0.1, initial-delay-min-value=0.01, initial-repetitions-base-delay=0.2, initial-repetitions-max=3}, service-find-time-to-live=10
  machine ECU1Machine: default-application-timeout=exit-timeout-value=1.0, machine-design=ECU1MachineDesign, trusted-platform-executable-launch-behavior=MONITOR-MODE
    function-groups:
      mode declaration group prototype AppMode: type=AppMode_ModeDeclarationGroup_1
      mode declaration group prototype MachineState: type=ECU1Machine_MachineState_ModeDeclarationGroup
    iam module instantiation ECU1Machine_IAMInstantiation: grant=[IAMApp01_Service01_Ins01_Event01_Grant, IAMApp01_Service01_Ins01_Field01_Grant, IAMApp01_Service01_Ins02_Event01_Grant, IAMApp01_Service01_Ins02_Field01_Grant, IAMApp02_Service01_Ins01_Method01_Grant, IAMApp02_Service01_Ins01_Event01_Grant, IAMApp02_Service01_Ins01_Field01_Grant, IAMApp03_Service01_Ins02_Method01_Grant, IAMApp03_Service01_Ins02_Event01_Grant, IAMApp03_Service01_Ins02_Field01_Grant]
  machine design ECU1MachineDesign: access-control=MODELED, pn-reset-timer=0.0, service-discover-configs=someip-service-discovery={multicast-sd-ip-address=ECU1SDNetworkEndpoint, someip-service-discovery-port=30490}
    ethernet communication connector ECU1CommunicationConnector: path-mtu-enabled=true, unicast-network-endpoint=ECU1NetworkEndpoint
  mode declaration group ECU1Machine_MachineState_ModeDeclarationGroup: initial-mode=Startup
    8 x mode:
      Driving
      Off
      Parking
      Restart
      Shutdown
      Startup
      Update
      Verify
  ethernet cluster EthCluster: protocol-name=System_Test_protocol
    ethernet physical channel EthPhysChannel1: comm-connectors=ECU1CommunicationConnector
      network endpoint ECU1NetworkEndpoint: network-endpoint-addresses=ipv-4-configuration={default-gateway=192.168.100.1, ip-address-keep-behavior=FORGET, ipv-4-address=192.168.100.5, ipv-4-address-source=FIXED, network-mask=255.255.255.0}
      network endpoint ECU1SDNetworkEndpoint: network-endpoint-addresses=ipv-4-configuration={ip-address-keep-behavior=FORGET, ipv-4-address=239.192.255.251, ipv-4-address-source=FIXED}
  hw element Memory1: hw-category=MemorySegment, hw-attribute-values=[{hw-attribute-def=memoryType, vt=EEPROM}, {hw-attribute-def=memorySize, v=1000000000}]
  mode declaration group ProcessState: initial-mode=Idle
    5 x mode:
      Idle
      Running
      Starting
      Terminated
      Terminating
  someip sd server service instance config ServerSdConfig_1: initial-offer-behavior={initial-delay-max-value=0.1, initial-delay-min-value=0.01, initial-repetitions-base-delay=0.2, initial-repetitions-max=3}, offer-cyclic-delay=2.0, request-response-delay={max-value=0.5, min-value=0.0}, service-offer-time-to-live=10
