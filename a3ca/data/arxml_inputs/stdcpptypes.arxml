AUTOSAR XML (schema 00048)
package /AUTOSAR/StdTypes
  6 x std cpp implementation data type, all with type-emitter=TYPE_EMITTER_ARA:
    ByteArray: category=VECTOR, cpp-template-argument=uint8_t
    ByteVectorType: category=VECTOR, cpp-template-argument=uint8_t
    EventResult: category=STRUCTURE
      cpp implementation data type element appNum: type-reference=uint32_t
      cpp implementation data type element count: type-reference=uint32_t
    FieldResult: category=STRUCTURE
      cpp implementation data type element appNum: type-reference=uint32_t
      cpp implementation data type element count: type-reference=uint32_t
    FindServiceResult: category=STRUCTURE
      cpp implementation data type element result: type-reference=bool
      cpp implementation data type element description: type-reference=String
    GenericResult: compu {0x00=rSuccess, 0x01=rFail, 0x02=rApplicationError, 0x03=rTimeOut, 0x04=rServiceNotAvailable, 0x05=rException}, type-reference=uint8_t
      namespaces:
        symbol props myproject
  16 x std cpp implementation data type:
    GrantResult: category=STRUCTURE, type-emitter=TYPE_EMITTER_ARA
      cpp implementation data type element callSuccess: type-reference=bool
      cpp implementation data type element appNum: type-reference=uint32_t
      cpp implementation data type element count: type-reference=uint32_t
    MethodResult: category=STRUCTURE, type-emitter=TYPE_EMITTER_ARA
      cpp implementation data type element appNum: type-reference=uint32_t
      cpp implementation data type element methodName: type-reference=String
      cpp implementation data type element count: type-reference=uint32_t
    OfferServiceResult: category=STRUCTURE, type-emitter=TYPE_EMITTER_ARA
      cpp implementation data type element result: type-reference=bool
      cpp implementation data type element description: type-reference=String
    String: category=STRING, type-emitter=TYPE_EMITTER_ARA
    StringVectorType: category=VECTOR, cpp-template-argument=String, type-emitter=TYPE_EMITTER_ARA
    bool: category=VALUE
    double: category=VALUE
    float: category=VALUE
    int16_t: category=VALUE, type-emitter=cstdint
    int32_t: category=VALUE, type-emitter=cstdint
    int64_t: category=VALUE, type-emitter=cstdint
    int8_t: category=VALUE, type-emitter=cstdint
    uint16_t: category=VALUE, type-emitter=cstdint
    uint32_t: category=VALUE, type-emitter=cstdint
    uint64_t: category=VALUE, type-emitter=cstdint
    uint8_t: category=VALUE, type-emitter=cstdint
