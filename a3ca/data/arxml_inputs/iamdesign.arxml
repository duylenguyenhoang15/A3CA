AUTOSAR XML (schema 00048)
package /myproject/IAMApp01
  com event grant design IAMApp01_Service01_Event01_GrantDesign: process-design=IAMApp01_processDesign, event=Event01
  com field grant design IAMApp01_Service01_Field01_GrantDesign: process-design=IAMApp01_processDesign, field=Field01, role=GETTER-SETTER
package /myproject/IAMApp01/Service01_Ins01/Event
  com event grant IAMApp01_Service01_Ins01_Event01_Grant: design=IAMApp01_Service01_Event01_GrantDesign, service-deployment=Someip_Event01Dep, service-instance=IAMApp01_IAMService01_Ins1_Provided_Instance
package /myproject/IAMApp01/Service01_Ins01/Field
  com field grant IAMApp01_Service01_Ins01_Field01_Grant: design=IAMApp01_Service01_Field01_GrantDesign, role=GETTER-SETTER, service-deployment=Someip_Field01Dep, service-instance=IAMApp01_IAMService01_Ins1_Provided_Instance
package /myproject/IAMApp01/Service01_Ins02/Event
  com event grant IAMApp01_Service01_Ins02_Event01_Grant: design=IAMApp01_Service01_Event01_GrantDesign, service-deployment=Someip_Event01Dep, service-instance=IAMApp01_IAMService01_Ins2_Provided_Instance
package /myproject/IAMApp01/Service01_Ins02/Field
  com field grant IAMApp01_Service01_Ins02_Field01_Grant: design=IAMApp01_Service01_Field01_GrantDesign, role=GETTER-SETTER, service-deployment=Someip_Field01Dep, service-instance=IAMApp01_IAMService01_Ins2_Provided_Instance
package /myproject/IAMApp02
  com event grant design IAMApp02_Service01_Event01_GrantDesign: process-design=IAMApp02_processDesign, event=Event01
  com field grant design IAMApp02_Service01_Field01_GrantDesign: process-design=IAMApp02_processDesign, field=Field01, role=GETTER-SETTER
  com method grant design IAMApp02_Service01_Method01_GrantDesign: process-design=IAMApp02_processDesign, method=Method01
package /myproject/IAMApp02/Service01_Ins01/Event
  com event grant IAMApp02_Service01_Ins01_Event01_Grant: design=IAMApp02_Service01_Event01_GrantDesign, service-deployment=Someip_Event01Dep, service-instance=IAMApp02_IAMService01_Required_Instance
package /myproject/IAMApp02/Service01_Ins01/Field
  com field grant IAMApp02_Service01_Ins01_Field01_Grant: design=IAMApp02_Service01_Field01_GrantDesign, role=GETTER-SETTER, service-deployment=Someip_Field01Dep, service-instance=IAMApp02_IAMService01_Required_Instance
package /myproject/IAMApp02/Service01_Ins01/Method
  com method grant IAMApp02_Service01_Ins01_Method01_Grant: design=IAMApp02_Service01_Method01_GrantDesign, service-deployment=Someip_Method01Dep, service-instance=IAMApp02_IAMService01_Required_Instance
package /myproject/IAMApp03
  com event grant design IAMApp03_Service01_Event01_GrantDesign: process-design=IAMApp03_processDesign, event=Event01
  com field grant design IAMApp03_Service01_Field01_GrantDesign: process-design=IAMApp03_processDesign, field=Field01, role=GETTER-SETTER
  com method grant design IAMApp03_Service01_Method01_GrantDesign: process-design=IAMApp03_processDesign, method=Method01
package /myproject/IAMApp03/Service01_Ins02/Event
  com event grant IAMApp03_Service01_Ins02_Event01_Grant: design=IAMApp03_Service01_Event01_GrantDesign, service-deployment=Someip_Event01Dep, service-instance=IAMApp03_IAMService01_Required_Instance
package /myproject/IAMApp03/Service01_Ins02/Field
  com field grant IAMApp03_Service01_Ins02_Field01_Grant: design=IAMApp03_Service01_Field01_GrantDesign, role=GETTER-SETTER, service-deployment=Someip_Field01Dep, service-instance=IAMApp03_IAMService01_Required_Instance
package /myproject/IAMApp03/Service01_Ins02/Method
  com method grant IAMApp03_Service01_Ins02_Method01_Grant: design=IAMApp03_Service01_Method01_GrantDesign, service-deployment=Someip_Method01Dep, service-instance=IAMApp03_IAMService01_Required_Instance
