AUTOSAR XML (schema 00048)
package /myproject/Service/Someip/Deployment
  someip service interface deployment IAMService01_Dep: service-interface=IAMService01, service-interface-id=1, service-interface-version={major-version=1, minor-version=0}
    someip event deployment Someip_Event01Dep: event=Event01, event-id=11, maximum-segment-length=0, separation-time=0.0, transport-protocol=UDP
    someip field deployment Someip_Field01Dep: field=Field01
      get Someip_Field01Dep_Getter: maximum-segment-length-request=0, maximum-segment-length-response=0, method-id=101, separation-time-request=0.0, separation-time-response=0.0, transport-protocol=UDP
      notifier Someip_Field01Dep_Notifier: event-id=111, maximum-segment-length=0, separation-time=0.0, transport-protocol=UDP
      set Someip_Field01Dep_Setter: maximum-segment-length-request=0, maximum-segment-length-response=0, method-id=102, separation-time-request=0.0, separation-time-response=0.0, transport-protocol=UDP
    someip method deployment Someip_Method01Dep: method=Method01, maximum-segment-length-request=0, maximum-segment-length-response=0, method-id=1, separation-time-request=0.0, separation-time-response=0.0, transport-protocol=UDP
    someip event group EventGroup_1: event-group-id=101, event=Someip_Event01Dep
    someip event group EventGroup_2: event-group-id=102, event=Someip_Field01Dep_Notifier
package /myproject/test
  service interface IAMService01: major-version=1, minor-version=0
    namespaces:
      symbol props myproject
      symbol props test
    events:
      data Event01: type=uint32_t
    field Field01: type=uint32_t, has-getter=true, has-notifier=true, has-setter=true
    methods:
      operation Method01: fire-and-forget=false
        arg appNumber: type=uint32_t, direction=IN
        arg result: type=MethodResult, direction=OUT
