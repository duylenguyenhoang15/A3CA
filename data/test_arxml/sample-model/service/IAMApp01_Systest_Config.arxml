AUTOSAR XML (schema 00048)
package /myproject/Service/Someip/Deployment
  someip service interface deployment IAMApp01_Systest_Config_Dep: service-interface=IAMApp01_Systest_Config, service-interface-id=4001, service-interface-version={major-version=1, minor-version=0}
    someip method deployment Someip_StartOfferServiceDep: method=StartOfferService, maximum-segment-length-request=0, maximum-segment-length-response=0, method-id=1, separation-time-request=0.0, separation-time-response=0.0, transport-protocol=UDP
package /myproject/test
  service interface IAMApp01_Systest_Config: major-version=1, minor-version=0
    namespaces:
      symbol props myproject
      symbol props test
    methods:
      operation StartOfferService: fire-and-forget=false
        arg serviceId: type=uint32_t, direction=IN
        arg result: type=bool, direction=OUT
        arg description: type=String, direction=OUT
